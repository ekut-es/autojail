## projects/odroidc2-test/board.yml
```yaml
name: odroidc2-test
board: odroidc2
pagesize: 0x1000
virtual_address_bits: 48
memory_regions:
  memory@0:
    physical_start_addr: 0x0
    virtual_start_addr: 0x0
    size: 0x80000000
    flags:
    - MEM_READ
    - MEM_WRITE
    - MEM_EXECUTE
    allocatable: true
    shared: false
    next_region:
    path:
    compatible: []
    interrupts: []
    aliases: []
  phy@c0000000:
    physical_start_addr: 0xc0000000
    virtual_start_addr: 0xc0000000
    size: 0x20
    flags:
    - MEM_READ
    - MEM_WRITE
    - MEM_IO
    - MEM_IO_8
    - MEM_IO_16
    - MEM_IO_32
    - MEM_IO_64
    allocatable: false
    shared: false
    next_region:
    path: /soc/phy@c0000000
    compatible:
    - amlogic,meson-gxbb-usb2-phy
    interrupts: []
    aliases: []
  phy@c0000020:
    physical_start_addr: 0xc0000020
    virtual_start_addr: 0xc0000020
    size: 0x20
    flags:
    - MEM_READ
    - MEM_WRITE
    - MEM_IO
    - MEM_IO_8
    - MEM_IO_16
    - MEM_IO_32
    - MEM_IO_64
    allocatable: false
    shared: false
    next_region:
    path: /soc/phy@c0000020
    compatible:
    - amlogic,meson-gxbb-usb2-phy
    interrupts: []
    aliases: []
  bus@c1100000:
    physical_start_addr: 0xc1100000
    virtual_start_addr: 0xc1100000
    size: 0x100000
    flags:
    - MEM_READ
    - MEM_WRITE
    - MEM_IO
    - MEM_IO_8
    - MEM_IO_16
    - MEM_IO_32
    - MEM_IO_64
    allocatable: false
    shared: false
    next_region:
    path: /soc/bus@c1100000
    compatible:
    - simple-bus
    interrupts: []
    aliases: []
  reset-controller@4404:
    physical_start_addr: 0xc1104404
    virtual_start_addr: 0xc1104404
    size: 0x9c
    flags:
    - MEM_READ
    - MEM_WRITE
    - MEM_IO
    - MEM_IO_8
    - MEM_IO_16
    - MEM_IO_32
    - MEM_IO_64
    allocatable: false
    shared: false
    next_region:
    path: /soc/bus@c1100000/reset-controller@4404
    compatible:
    - amlogic,meson-gx-reset
    - amlogic,meson-gxbb-reset
    interrupts: []
    aliases: []
  audio@5400:
    physical_start_addr: 0xc1105400
    virtual_start_addr: 0xc1105400
    size: 0x2ac
    flags:
    - MEM_READ
    - MEM_WRITE
    - MEM_IO
    - MEM_IO_8
    - MEM_IO_16
    - MEM_IO_32
    - MEM_IO_64
    allocatable: false
    shared: false
    next_region:
    path: /soc/bus@c1100000/audio@5400
    compatible:
    - amlogic,meson-audio-core
    interrupts: []
    aliases: []
  serial@84c0:
    physical_start_addr: 0xc11084c0
    virtual_start_addr: 0xc11084c0
    size: 0x18
    flags:
    - MEM_READ
    - MEM_WRITE
    - MEM_IO
    - MEM_IO_8
    - MEM_IO_16
    - MEM_IO_32
    - MEM_IO_64
    allocatable: false
    shared: false
    next_region:
    path: /soc/bus@c1100000/serial@84c0
    compatible:
    - amlogic,meson-gx-uart
    interrupts:
    - 26
    aliases: []
  serial@84dc:
    physical_start_addr: 0xc11084dc
    virtual_start_addr: 0xc11084dc
    size: 0x18
    flags:
    - MEM_READ
    - MEM_WRITE
    - MEM_IO
    - MEM_IO_8
    - MEM_IO_16
    - MEM_IO_32
    - MEM_IO_64
    allocatable: false
    shared: false
    next_region:
    path: /soc/bus@c1100000/serial@84dc
    compatible:
    - amlogic,meson-gx-uart
    interrupts:
    - 75
    aliases: []
  i2c@8500:
    physical_start_addr: 0xc1108500
    virtual_start_addr: 0xc1108500
    size: 0x20
    flags:
    - MEM_READ
    - MEM_WRITE
    - MEM_IO
    - MEM_IO_8
    - MEM_IO_16
    - MEM_IO_32
    - MEM_IO_64
    allocatable: false
    shared: false
    next_region:
    path: /soc/bus@c1100000/i2c@8500
    compatible:
    - amlogic,meson-gx-i2c
    - amlogic,meson-gxbb-i2c
    interrupts:
    - 21
    aliases: []
  pwm@8550:
    physical_start_addr: 0xc1108550
    virtual_start_addr: 0xc1108550
    size: 0x10
    flags:
    - MEM_READ
    - MEM_WRITE
    - MEM_IO
    - MEM_IO_8
    - MEM_IO_16
    - MEM_IO_32
    - MEM_IO_64
    allocatable: false
    shared: false
    next_region:
    path: /soc/bus@c1100000/pwm@8550
    compatible:
    - amlogic,meson-gx-pwm
    - amlogic,meson-gxbb-pwm
    interrupts: []
    aliases: []
  pwm@8650:
    physical_start_addr: 0xc1108650
    virtual_start_addr: 0xc1108650
    size: 0x10
    flags:
    - MEM_READ
    - MEM_WRITE
    - MEM_IO
    - MEM_IO_8
    - MEM_IO_16
    - MEM_IO_32
    - MEM_IO_64
    allocatable: false
    shared: false
    next_region:
    path: /soc/bus@c1100000/pwm@8650
    compatible:
    - amlogic,meson-gx-pwm
    - amlogic,meson-gxbb-pwm
    interrupts: []
    aliases: []
  adc@8680:
    physical_start_addr: 0xc1108680
    virtual_start_addr: 0xc1108680
    size: 0x34
    flags:
    - MEM_READ
    - MEM_WRITE
    - MEM_IO
    - MEM_IO_8
    - MEM_IO_16
    - MEM_IO_32
    - MEM_IO_64
    allocatable: false
    shared: false
    next_region:
    path: /soc/bus@c1100000/adc@8680
    compatible:
    - amlogic,meson-gxbb-saradc
    - amlogic,meson-saradc
    interrupts:
    - 73
    aliases: []
  pwm@86c0:
    physical_start_addr: 0xc11086c0
    virtual_start_addr: 0xc11086c0
    size: 0x10
    flags:
    - MEM_READ
    - MEM_WRITE
    - MEM_IO
    - MEM_IO_8
    - MEM_IO_16
    - MEM_IO_32
    - MEM_IO_64
    allocatable: false
    shared: false
    next_region:
    path: /soc/bus@c1100000/pwm@86c0
    compatible:
    - amlogic,meson-gx-pwm
    - amlogic,meson-gxbb-pwm
    interrupts: []
    aliases: []
  serial@8700:
    physical_start_addr: 0xc1108700
    virtual_start_addr: 0xc1108700
    size: 0x18
    flags:
    - MEM_READ
    - MEM_WRITE
    - MEM_IO
    - MEM_IO_8
    - MEM_IO_16
    - MEM_IO_32
    - MEM_IO_64
    allocatable: false
    shared: false
    next_region:
    path: /soc/bus@c1100000/serial@8700
    compatible:
    - amlogic,meson-gx-uart
    interrupts:
    - 93
    aliases: []
  clock-measure@8758:
    physical_start_addr: 0xc1108758
    virtual_start_addr: 0xc1108758
    size: 0x10
    flags:
    - MEM_READ
    - MEM_WRITE
    - MEM_IO
    - MEM_IO_8
    - MEM_IO_16
    - MEM_IO_32
    - MEM_IO_64
    allocatable: false
    shared: false
    next_region:
    path: /soc/bus@c1100000/clock-measure@8758
    compatible:
    - amlogic,meson-gx-clk-measure
    interrupts: []
    aliases: []
  i2c@87c0:
    physical_start_addr: 0xc11087c0
    virtual_start_addr: 0xc11087c0
    size: 0x20
    flags:
    - MEM_READ
    - MEM_WRITE
    - MEM_IO
    - MEM_IO_8
    - MEM_IO_16
    - MEM_IO_32
    - MEM_IO_64
    allocatable: false
    shared: false
    next_region:
    path: /soc/bus@c1100000/i2c@87c0
    compatible:
    - amlogic,meson-gx-i2c
    - amlogic,meson-gxbb-i2c
    interrupts:
    - 214
    aliases: []
  i2c@87e0:
    physical_start_addr: 0xc11087e0
    virtual_start_addr: 0xc11087e0
    size: 0x20
    flags:
    - MEM_READ
    - MEM_WRITE
    - MEM_IO
    - MEM_IO_8
    - MEM_IO_16
    - MEM_IO_32
    - MEM_IO_64
    allocatable: false
    shared: false
    next_region:
    path: /soc/bus@c1100000/i2c@87e0
    compatible:
    - amlogic,meson-gx-i2c
    - amlogic,meson-gxbb-i2c
    interrupts:
    - 215
    aliases: []
  spi@8c80:
    physical_start_addr: 0xc1108c80
    virtual_start_addr: 0xc1108c80
    size: 0x80
    flags:
    - MEM_READ
    - MEM_WRITE
    - MEM_IO
    - MEM_IO_8
    - MEM_IO_16
    - MEM_IO_32
    - MEM_IO_64
    allocatable: false
    shared: false
    next_region:
    path: /soc/bus@c1100000/spi@8c80
    compatible:
    - amlogic,meson-gxbb-spifc
    interrupts: []
    aliases: []
  spi@8d80:
    physical_start_addr: 0xc1108d80
    virtual_start_addr: 0xc1108d80
    size: 0x80
    flags:
    - MEM_READ
    - MEM_WRITE
    - MEM_IO
    - MEM_IO_8
    - MEM_IO_16
    - MEM_IO_32
    - MEM_IO_64
    allocatable: false
    shared: false
    next_region:
    path: /soc/bus@c1100000/spi@8d80
    compatible:
    - amlogic,meson-gx-spicc
    interrupts:
    - 81
    aliases: []
  watchdog@98d0:
    physical_start_addr: 0xc11098d0
    virtual_start_addr: 0xc11098d0
    size: 0x10
    flags:
    - MEM_READ
    - MEM_WRITE
    - MEM_IO
    - MEM_IO_8
    - MEM_IO_16
    - MEM_IO_32
    - MEM_IO_64
    allocatable: false
    shared: false
    next_region:
    path: /soc/bus@c1100000/watchdog@98d0
    compatible:
    - amlogic,meson-gx-wdt
    - amlogic,meson-gxbb-wdt
    interrupts: []
    aliases: []
  audio@5400.0:
    physical_start_addr: 0xc110a000
    virtual_start_addr: 0xc110a000
    size: 0x2ac
    flags:
    - MEM_READ
    - MEM_WRITE
    - MEM_IO
    - MEM_IO_8
    - MEM_IO_16
    - MEM_IO_32
    - MEM_IO_64
    allocatable: false
    shared: false
    next_region:
    path: /soc/bus@c1100000/audio@5400
    compatible:
    - amlogic,meson-audio-core
    interrupts: []
    aliases: []
  video-decoder@c8820000.0:
    physical_start_addr: 0xc110a580
    virtual_start_addr: 0xc110a580
    size: 0x10000
    flags:
    - MEM_READ
    - MEM_WRITE
    - MEM_IO
    - MEM_IO_8
    - MEM_IO_16
    - MEM_IO_32
    - MEM_IO_64
    allocatable: false
    shared: false
    next_region:
    path: /soc/video-decoder@c8820000
    compatible:
    - amlogic,gxbb-vdec
    interrupts:
    - 44
    - 32
    aliases: []
  sram@c8000000:
    physical_start_addr: 0xc8000000
    virtual_start_addr: 0xc8000000
    size: 0x14000
    flags:
    - MEM_READ
    - MEM_WRITE
    - MEM_IO
    - MEM_IO_8
    - MEM_IO_16
    - MEM_IO_32
    - MEM_IO_64
    allocatable: false
    shared: false
    next_region:
    path: /soc/sram@c8000000
    compatible:
    - amlogic,meson-gx-sram
    - amlogic,meson-gxbb-sram
    - mmio-sram
    interrupts: []
    aliases: []
  bus@c8100000:
    physical_start_addr: 0xc8100000
    virtual_start_addr: 0xc8100000
    size: 0x100000
    flags:
    - MEM_READ
    - MEM_WRITE
    - MEM_IO
    - MEM_IO_8
    - MEM_IO_16
    - MEM_IO_32
    - MEM_IO_64
    allocatable: false
    shared: false
    next_region:
    path: /soc/bus@c8100000
    compatible:
    - simple-bus
    interrupts: []
    aliases: []
  sys-ctrl@0:
    physical_start_addr: 0xc8100000
    virtual_start_addr: 0xc8100000
    size: 0x100
    flags:
    - MEM_READ
    - MEM_WRITE
    - MEM_IO
    - MEM_IO_8
    - MEM_IO_16
    - MEM_IO_32
    - MEM_IO_64
    allocatable: false
    shared: false
    next_region:
    path: /soc/bus@c8100000/sys-ctrl@0
    compatible:
    - amlogic,meson-gx-ao-sysctrl
    - simple-mfd
    - syscon
    interrupts: []
    aliases: []
  cec@100:
    physical_start_addr: 0xc8100100
    virtual_start_addr: 0xc8100100
    size: 0x14
    flags:
    - MEM_READ
    - MEM_WRITE
    - MEM_IO
    - MEM_IO_8
    - MEM_IO_16
    - MEM_IO_32
    - MEM_IO_64
    allocatable: false
    shared: false
    next_region:
    path: /soc/bus@c8100000/cec@100
    compatible:
    - amlogic,meson-gx-ao-cec
    interrupts:
    - 199
    aliases: []
  ao-secure@140:
    physical_start_addr: 0xc8100140
    virtual_start_addr: 0xc8100140
    size: 0x140
    flags:
    - MEM_READ
    - MEM_WRITE
    - MEM_IO
    - MEM_IO_8
    - MEM_IO_16
    - MEM_IO_32
    - MEM_IO_64
    allocatable: false
    shared: false
    next_region:
    path: /soc/bus@c8100000/ao-secure@140
    compatible:
    - amlogic,meson-gx-ao-secure
    - syscon
    interrupts: []
    aliases: []
  serial@4c0:
    physical_start_addr: 0xc81004c0
    virtual_start_addr: 0xc81004c0
    size: 0x18
    flags:
    - MEM_READ
    - MEM_WRITE
    - MEM_IO
    - MEM_IO_8
    - MEM_IO_16
    - MEM_IO_32
    - MEM_IO_64
    allocatable: false
    shared: false
    next_region:
    path: /soc/bus@c8100000/serial@4c0
    compatible:
    - amlogic,meson-gx-uart
    - amlogic,meson-ao-uart
    interrupts:
    - 193
    aliases:
    - serial0
  serial@4e0:
    physical_start_addr: 0xc81004e0
    virtual_start_addr: 0xc81004e0
    size: 0x18
    flags:
    - MEM_READ
    - MEM_WRITE
    - MEM_IO
    - MEM_IO_8
    - MEM_IO_16
    - MEM_IO_32
    - MEM_IO_64
    allocatable: false
    shared: false
    next_region:
    path: /soc/bus@c8100000/serial@4e0
    compatible:
    - amlogic,meson-gx-uart
    - amlogic,meson-ao-uart
    interrupts:
    - 197
    aliases: []
  i2c@500:
    physical_start_addr: 0xc8100500
    virtual_start_addr: 0xc8100500
    size: 0x20
    flags:
    - MEM_READ
    - MEM_WRITE
    - MEM_IO
    - MEM_IO_8
    - MEM_IO_16
    - MEM_IO_32
    - MEM_IO_64
    allocatable: false
    shared: false
    next_region:
    path: /soc/bus@c8100000/i2c@500
    compatible:
    - amlogic,meson-gx-i2c
    - amlogic,meson-gxbb-i2c
    interrupts:
    - 195
    aliases: []
  pwm@550:
    physical_start_addr: 0xc8100550
    virtual_start_addr: 0xc8100550
    size: 0x10
    flags:
    - MEM_READ
    - MEM_WRITE
    - MEM_IO
    - MEM_IO_8
    - MEM_IO_16
    - MEM_IO_32
    - MEM_IO_64
    allocatable: false
    shared: false
    next_region:
    path: /soc/bus@c8100000/pwm@550
    compatible:
    - amlogic,meson-gx-ao-pwm
    - amlogic,meson-gxbb-ao-pwm
    interrupts: []
    aliases: []
  ir@580:
    physical_start_addr: 0xc8100580
    virtual_start_addr: 0xc8100580
    size: 0x40
    flags:
    - MEM_READ
    - MEM_WRITE
    - MEM_IO
    - MEM_IO_8
    - MEM_IO_16
    - MEM_IO_32
    - MEM_IO_64
    allocatable: false
    shared: false
    next_region:
    path: /soc/bus@c8100000/ir@580
    compatible:
    - amlogic,meson-gx-ir
    - amlogic,meson-gxbb-ir
    interrupts:
    - 196
    aliases: []
  video-decoder@c8820000:
    physical_start_addr: 0xc8820000
    virtual_start_addr: 0xc8820000
    size: 0x10000
    flags:
    - MEM_READ
    - MEM_WRITE
    - MEM_IO
    - MEM_IO_8
    - MEM_IO_16
    - MEM_IO_32
    - MEM_IO_64
    allocatable: false
    shared: false
    next_region:
    path: /soc/video-decoder@c8820000
    compatible:
    - amlogic,gxbb-vdec
    interrupts:
    - 44
    - 32
    aliases: []
  periphs@c8834000:
    physical_start_addr: 0xc8834000
    virtual_start_addr: 0xc8834000
    size: 0x2000
    flags:
    - MEM_READ
    - MEM_WRITE
    - MEM_IO
    - MEM_IO_8
    - MEM_IO_16
    - MEM_IO_32
    - MEM_IO_64
    allocatable: false
    shared: false
    next_region:
    path: /soc/periphs@c8834000
    compatible:
    - simple-bus
    interrupts: []
    aliases: []
  rng:
    physical_start_addr: 0xc8834000
    virtual_start_addr: 0xc8834000
    size: 0x4
    flags:
    - MEM_READ
    - MEM_WRITE
    - MEM_IO
    - MEM_IO_8
    - MEM_IO_16
    - MEM_IO_32
    - MEM_IO_64
    allocatable: false
    shared: false
    next_region:
    path: /soc/periphs@c8834000/rng
    compatible:
    - amlogic,meson-rng
    interrupts: []
    aliases: []
  ethernet@c9410000.0:
    physical_start_addr: 0xc8834540
    virtual_start_addr: 0xc8834540
    size: 0x10000
    flags:
    - MEM_READ
    - MEM_WRITE
    - MEM_IO
    - MEM_IO_8
    - MEM_IO_16
    - MEM_IO_32
    - MEM_IO_64
    allocatable: false
    shared: false
    next_region:
    path: /soc/ethernet@c9410000
    compatible:
    - amlogic,meson-gx-dwmac
    - amlogic,meson-gxbb-dwmac
    - snps,dwmac
    interrupts:
    - 8
    aliases:
    - ethernet0
  bus@c8838000:
    physical_start_addr: 0xc8838000
    virtual_start_addr: 0xc8838000
    size: 0x400
    flags:
    - MEM_READ
    - MEM_WRITE
    - MEM_IO
    - MEM_IO_8
    - MEM_IO_16
    - MEM_IO_32
    - MEM_IO_64
    allocatable: false
    shared: false
    next_region:
    path: /soc/bus@c8838000
    compatible:
    - simple-bus
    interrupts: []
    aliases: []
  vpu@d0100000.1:
    physical_start_addr: 0xc8838000
    virtual_start_addr: 0xc8838000
    size: 0x100000
    flags:
    - MEM_READ
    - MEM_WRITE
    - MEM_IO
    - MEM_IO_8
    - MEM_IO_16
    - MEM_IO_32
    - MEM_IO_64
    allocatable: false
    shared: false
    next_region:
    path: /soc/vpu@d0100000
    compatible:
    - amlogic,meson-gxbb-vpu
    - amlogic,meson-gx-vpu
    interrupts:
    - 3
    aliases: []
  video-lut@48:
    physical_start_addr: 0xc8838048
    virtual_start_addr: 0xc8838048
    size: 0x14
    flags:
    - MEM_READ
    - MEM_WRITE
    - MEM_IO
    - MEM_IO_8
    - MEM_IO_16
    - MEM_IO_32
    - MEM_IO_64
    allocatable: false
    shared: false
    next_region:
    path: /soc/bus@c8838000/video-lut@48
    compatible:
    - amlogic,canvas
    interrupts: []
    aliases: []
  hdmi-tx@c883a000:
    physical_start_addr: 0xc883a000
    virtual_start_addr: 0xc883a000
    size: 0x1c
    flags:
    - MEM_READ
    - MEM_WRITE
    - MEM_IO
    - MEM_IO_8
    - MEM_IO_16
    - MEM_IO_32
    - MEM_IO_64
    allocatable: false
    shared: false
    next_region:
    path: /soc/hdmi-tx@c883a000
    compatible:
    - amlogic,meson-gxbb-dw-hdmi
    - amlogic,meson-gx-dw-hdmi
    interrupts:
    - 57
    aliases: []
  bus@c883c000:
    physical_start_addr: 0xc883c000
    virtual_start_addr: 0xc883c000
    size: 0x2000
    flags:
    - MEM_READ
    - MEM_WRITE
    - MEM_IO
    - MEM_IO_8
    - MEM_IO_16
    - MEM_IO_32
    - MEM_IO_64
    allocatable: false
    shared: false
    next_region:
    path: /soc/bus@c883c000
    compatible:
    - simple-bus
    interrupts: []
    aliases: []
  system-controller@0:
    physical_start_addr: 0xc883c000
    virtual_start_addr: 0xc883c000
    size: 0x400
    flags:
    - MEM_READ
    - MEM_WRITE
    - MEM_IO
    - MEM_IO_8
    - MEM_IO_16
    - MEM_IO_32
    - MEM_IO_64
    allocatable: false
    shared: false
    next_region:
    path: /soc/bus@c883c000/system-controller@0
    compatible:
    - amlogic,meson-gx-hhi-sysctrl
    - simple-mfd
    - syscon
    interrupts: []
    aliases: []
  vpu@d0100000.0:
    physical_start_addr: 0xc883c000
    virtual_start_addr: 0xc883c000
    size: 0x100000
    flags:
    - MEM_READ
    - MEM_WRITE
    - MEM_IO
    - MEM_IO_8
    - MEM_IO_16
    - MEM_IO_32
    - MEM_IO_64
    allocatable: false
    shared: false
    next_region:
    path: /soc/vpu@d0100000
    compatible:
    - amlogic,meson-gxbb-vpu
    - amlogic,meson-gx-vpu
    interrupts:
    - 3
    aliases: []
  mailbox@404:
    physical_start_addr: 0xc883c404
    virtual_start_addr: 0xc883c404
    size: 0x4c
    flags:
    - MEM_READ
    - MEM_WRITE
    - MEM_IO
    - MEM_IO_8
    - MEM_IO_16
    - MEM_IO_32
    - MEM_IO_64
    allocatable: false
    shared: false
    next_region:
    path: /soc/bus@c883c000/mailbox@404
    compatible:
    - amlogic,meson-gx-mhu
    - amlogic,meson-gxbb-mhu
    interrupts:
    - 208
    - 209
    - 210
    aliases: []
  usb@c9000000:
    physical_start_addr: 0xc9000000
    virtual_start_addr: 0xc9000000
    size: 0x40000
    flags:
    - MEM_READ
    - MEM_WRITE
    - MEM_IO
    - MEM_IO_8
    - MEM_IO_16
    - MEM_IO_32
    - MEM_IO_64
    allocatable: false
    shared: false
    next_region:
    path: /soc/usb@c9000000
    compatible:
    - amlogic,meson-gxbb-usb
    - snps,dwc2
    interrupts:
    - 30
    aliases: []
  usb@c9100000:
    physical_start_addr: 0xc9100000
    virtual_start_addr: 0xc9100000
    size: 0x40000
    flags:
    - MEM_READ
    - MEM_WRITE
    - MEM_IO
    - MEM_IO_8
    - MEM_IO_16
    - MEM_IO_32
    - MEM_IO_64
    allocatable: false
    shared: false
    next_region:
    path: /soc/usb@c9100000
    compatible:
    - amlogic,meson-gxbb-usb
    - snps,dwc2
    interrupts:
    - 31
    aliases: []
  ethernet@c9410000:
    physical_start_addr: 0xc9410000
    virtual_start_addr: 0xc9410000
    size: 0x10000
    flags:
    - MEM_READ
    - MEM_WRITE
    - MEM_IO
    - MEM_IO_8
    - MEM_IO_16
    - MEM_IO_32
    - MEM_IO_64
    allocatable: false
    shared: false
    next_region:
    path: /soc/ethernet@c9410000
    compatible:
    - amlogic,meson-gx-dwmac
    - amlogic,meson-gxbb-dwmac
    - snps,dwmac
    interrupts:
    - 8
    aliases:
    - ethernet0
  apb@d0000000:
    physical_start_addr: 0xd0000000
    virtual_start_addr: 0xd0000000
    size: 0x200000
    flags:
    - MEM_READ
    - MEM_WRITE
    - MEM_IO
    - MEM_IO_8
    - MEM_IO_16
    - MEM_IO_32
    - MEM_IO_64
    allocatable: false
    shared: false
    next_region:
    path: /soc/apb@d0000000
    compatible:
    - simple-bus
    interrupts: []
    aliases: []
  mmc@70000:
    physical_start_addr: 0xd0070000
    virtual_start_addr: 0xd0070000
    size: 0x800
    flags:
    - MEM_READ
    - MEM_WRITE
    - MEM_IO
    - MEM_IO_8
    - MEM_IO_16
    - MEM_IO_32
    - MEM_IO_64
    allocatable: false
    shared: false
    next_region:
    path: /soc/apb@d0000000/mmc@70000
    compatible:
    - amlogic,meson-gx-mmc
    - amlogic,meson-gxbb-mmc
    interrupts:
    - 216
    aliases: []
  mmc@72000:
    physical_start_addr: 0xd0072000
    virtual_start_addr: 0xd0072000
    size: 0x800
    flags:
    - MEM_READ
    - MEM_WRITE
    - MEM_IO
    - MEM_IO_8
    - MEM_IO_16
    - MEM_IO_32
    - MEM_IO_64
    allocatable: false
    shared: false
    next_region:
    path: /soc/apb@d0000000/mmc@72000
    compatible:
    - amlogic,meson-gx-mmc
    - amlogic,meson-gxbb-mmc
    interrupts:
    - 217
    aliases: []
  mmc@74000:
    physical_start_addr: 0xd0074000
    virtual_start_addr: 0xd0074000
    size: 0x800
    flags:
    - MEM_READ
    - MEM_WRITE
    - MEM_IO
    - MEM_IO_8
    - MEM_IO_16
    - MEM_IO_32
    - MEM_IO_64
    allocatable: false
    shared: false
    next_region:
    path: /soc/apb@d0000000/mmc@74000
    compatible:
    - amlogic,meson-gx-mmc
    - amlogic,meson-gxbb-mmc
    interrupts:
    - 218
    aliases: []
  gpu@c0000:
    physical_start_addr: 0xd00c0000
    virtual_start_addr: 0xd00c0000
    size: 0x40000
    flags:
    - MEM_READ
    - MEM_WRITE
    - MEM_IO
    - MEM_IO_8
    - MEM_IO_16
    - MEM_IO_32
    - MEM_IO_64
    allocatable: false
    shared: false
    next_region:
    path: /soc/apb@d0000000/gpu@c0000
    compatible:
    - amlogic,meson-gxbb-mali
    - arm,mali-450
    interrupts:
    - 160
    - 161
    - 162
    - 163
    - 164
    - 165
    - 166
    - 167
    - 168
    - 169
    aliases: []
  vpu@d0100000:
    physical_start_addr: 0xd0100000
    virtual_start_addr: 0xd0100000
    size: 0x100000
    flags:
    - MEM_READ
    - MEM_WRITE
    - MEM_IO
    - MEM_IO_8
    - MEM_IO_16
    - MEM_IO_32
    - MEM_IO_64
    allocatable: false
    shared: false
    next_region:
    path: /soc/vpu@d0100000
    compatible:
    - amlogic,meson-gxbb-vpu
    - amlogic,meson-gx-vpu
    interrupts:
    - 3
    aliases: []
interrupt_controllers:
- maintenance_irq: 25
  gic_version: 2
  gicd_base: 0x0
  gicc_base: 0x0
  gich_base: 0x0
  gicv_base: 0x0
  gicr_base: 0x0
  interrupts: 3,8,21,26,30,31,32,44,57,73,75,81,93,160,161,162,163,164,165,166,167,168,169,193,195,196,197,199,208,209,210,214,215,216,217,218
```
