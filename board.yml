## projects/qemu_net/board.yml
```yaml
name: qemu_net
board: qemu_net
pagesize: 0x1000
stdout_path: /pl011@9000000
virtual_address_bits: 48
memory_regions:
  flash@0:
    path: /flash@0
    name: flash@0
    phandle:
    compatible:
    - cfi-flash
    interrupts: []
    aliases: []
    clock_names: []
    clocks: []
    clock_output_names: []
    clock_cells: 0
    physical_start_addr: 0x0
    virtual_start_addr: 0x0
    size: 0x4000000
    flags:
    - MEM_READ
    - MEM_WRITE
    - MEM_IO
    - MEM_IO_8
    - MEM_IO_16
    - MEM_IO_32
    - MEM_IO_64
    allocatable: false
    shared: false
  flash@0.0:
    path: /flash@0
    name: flash@0
    phandle:
    compatible:
    - cfi-flash
    interrupts: []
    aliases: []
    clock_names: []
    clocks: []
    clock_output_names: []
    clock_cells: 0
    physical_start_addr: 0x4000000
    virtual_start_addr: 0x4000000
    size: 0x4000000
    flags:
    - MEM_READ
    - MEM_WRITE
    - MEM_IO
    - MEM_IO_8
    - MEM_IO_16
    - MEM_IO_32
    - MEM_IO_64
    allocatable: false
    shared: false
  pl011@9000000:
    path: /pl011@9000000
    name: pl011@9000000
    phandle:
    compatible:
    - arm,pl011
    - arm,primecell
    interrupts:
    - type: 0x0
      num: 1
      flags: 0x4
    aliases: []
    clock_names:
    - uartclk
    - apb_pclk
    clocks:
    - '32768'
    - '32768'
    clock_output_names: []
    clock_cells: 0
    physical_start_addr: 0x9000000
    virtual_start_addr: 0x9000000
    size: 0x1000
    flags:
    - MEM_READ
    - MEM_WRITE
    - MEM_IO
    - MEM_IO_8
    - MEM_IO_16
    - MEM_IO_32
    - MEM_IO_64
    allocatable: false
    shared: false
  pl031@9010000:
    path: /pl031@9010000
    name: pl031@9010000
    phandle:
    compatible:
    - arm,pl031
    - arm,primecell
    interrupts:
    - type: 0x0
      num: 2
      flags: 0x4
    aliases: []
    clock_names:
    - apb_pclk
    clocks:
    - '32768'
    clock_output_names: []
    clock_cells: 0
    physical_start_addr: 0x9010000
    virtual_start_addr: 0x9010000
    size: 0x1000
    flags:
    - MEM_READ
    - MEM_WRITE
    - MEM_IO
    - MEM_IO_8
    - MEM_IO_16
    - MEM_IO_32
    - MEM_IO_64
    allocatable: false
    shared: false
  fw-cfg@9020000:
    path: /fw-cfg@9020000
    name: fw-cfg@9020000
    phandle:
    compatible:
    - qemu,fw-cfg-mmio
    interrupts: []
    aliases: []
    clock_names: []
    clocks: []
    clock_output_names: []
    clock_cells: 0
    physical_start_addr: 0x9020000
    virtual_start_addr: 0x9020000
    size: 0x18
    flags:
    - MEM_READ
    - MEM_WRITE
    - MEM_IO
    - MEM_IO_8
    - MEM_IO_16
    - MEM_IO_32
    - MEM_IO_64
    allocatable: false
    shared: false
  pl061@9030000:
    path: /pl061@9030000
    name: pl061@9030000
    phandle: 32770
    compatible:
    - arm,pl061
    - arm,primecell
    interrupts:
    - type: 0x0
      num: 7
      flags: 0x4
    aliases: []
    clock_names:
    - apb_pclk
    clocks:
    - '32768'
    clock_output_names: []
    clock_cells: 0
    physical_start_addr: 0x9030000
    virtual_start_addr: 0x9030000
    size: 0x1000
    flags:
    - MEM_READ
    - MEM_WRITE
    - MEM_IO
    - MEM_IO_8
    - MEM_IO_16
    - MEM_IO_32
    - MEM_IO_64
    allocatable: false
    shared: false
  virtio_mmio@a000000:
    path: /virtio_mmio@a000000
    name: virtio_mmio@a000000
    phandle:
    compatible:
    - virtio,mmio
    interrupts:
    - type: 0x0
      num: 16
      flags: 0x1
    aliases: []
    clock_names: []
    clocks: []
    clock_output_names: []
    clock_cells: 0
    physical_start_addr: 0xa000000
    virtual_start_addr: 0xa000000
    size: 0x200
    flags:
    - MEM_READ
    - MEM_WRITE
    - MEM_IO
    - MEM_IO_8
    - MEM_IO_16
    - MEM_IO_32
    - MEM_IO_64
    allocatable: false
    shared: false
  virtio_mmio@a000200:
    path: /virtio_mmio@a000200
    name: virtio_mmio@a000200
    phandle:
    compatible:
    - virtio,mmio
    interrupts:
    - type: 0x0
      num: 17
      flags: 0x1
    aliases: []
    clock_names: []
    clocks: []
    clock_output_names: []
    clock_cells: 0
    physical_start_addr: 0xa000200
    virtual_start_addr: 0xa000200
    size: 0x200
    flags:
    - MEM_READ
    - MEM_WRITE
    - MEM_IO
    - MEM_IO_8
    - MEM_IO_16
    - MEM_IO_32
    - MEM_IO_64
    allocatable: false
    shared: false
  virtio_mmio@a000400:
    path: /virtio_mmio@a000400
    name: virtio_mmio@a000400
    phandle:
    compatible:
    - virtio,mmio
    interrupts:
    - type: 0x0
      num: 18
      flags: 0x1
    aliases: []
    clock_names: []
    clocks: []
    clock_output_names: []
    clock_cells: 0
    physical_start_addr: 0xa000400
    virtual_start_addr: 0xa000400
    size: 0x200
    flags:
    - MEM_READ
    - MEM_WRITE
    - MEM_IO
    - MEM_IO_8
    - MEM_IO_16
    - MEM_IO_32
    - MEM_IO_64
    allocatable: false
    shared: false
  virtio_mmio@a000600:
    path: /virtio_mmio@a000600
    name: virtio_mmio@a000600
    phandle:
    compatible:
    - virtio,mmio
    interrupts:
    - type: 0x0
      num: 19
      flags: 0x1
    aliases: []
    clock_names: []
    clocks: []
    clock_output_names: []
    clock_cells: 0
    physical_start_addr: 0xa000600
    virtual_start_addr: 0xa000600
    size: 0x200
    flags:
    - MEM_READ
    - MEM_WRITE
    - MEM_IO
    - MEM_IO_8
    - MEM_IO_16
    - MEM_IO_32
    - MEM_IO_64
    allocatable: false
    shared: false
  virtio_mmio@a000800:
    path: /virtio_mmio@a000800
    name: virtio_mmio@a000800
    phandle:
    compatible:
    - virtio,mmio
    interrupts:
    - type: 0x0
      num: 20
      flags: 0x1
    aliases: []
    clock_names: []
    clocks: []
    clock_output_names: []
    clock_cells: 0
    physical_start_addr: 0xa000800
    virtual_start_addr: 0xa000800
    size: 0x200
    flags:
    - MEM_READ
    - MEM_WRITE
    - MEM_IO
    - MEM_IO_8
    - MEM_IO_16
    - MEM_IO_32
    - MEM_IO_64
    allocatable: false
    shared: false
  virtio_mmio@a000a00:
    path: /virtio_mmio@a000a00
    name: virtio_mmio@a000a00
    phandle:
    compatible:
    - virtio,mmio
    interrupts:
    - type: 0x0
      num: 21
      flags: 0x1
    aliases: []
    clock_names: []
    clocks: []
    clock_output_names: []
    clock_cells: 0
    physical_start_addr: 0xa000a00
    virtual_start_addr: 0xa000a00
    size: 0x200
    flags:
    - MEM_READ
    - MEM_WRITE
    - MEM_IO
    - MEM_IO_8
    - MEM_IO_16
    - MEM_IO_32
    - MEM_IO_64
    allocatable: false
    shared: false
  virtio_mmio@a000c00:
    path: /virtio_mmio@a000c00
    name: virtio_mmio@a000c00
    phandle:
    compatible:
    - virtio,mmio
    interrupts:
    - type: 0x0
      num: 22
      flags: 0x1
    aliases: []
    clock_names: []
    clocks: []
    clock_output_names: []
    clock_cells: 0
    physical_start_addr: 0xa000c00
    virtual_start_addr: 0xa000c00
    size: 0x200
    flags:
    - MEM_READ
    - MEM_WRITE
    - MEM_IO
    - MEM_IO_8
    - MEM_IO_16
    - MEM_IO_32
    - MEM_IO_64
    allocatable: false
    shared: false
  virtio_mmio@a000e00:
    path: /virtio_mmio@a000e00
    name: virtio_mmio@a000e00
    phandle:
    compatible:
    - virtio,mmio
    interrupts:
    - type: 0x0
      num: 23
      flags: 0x1
    aliases: []
    clock_names: []
    clocks: []
    clock_output_names: []
    clock_cells: 0
    physical_start_addr: 0xa000e00
    virtual_start_addr: 0xa000e00
    size: 0x200
    flags:
    - MEM_READ
    - MEM_WRITE
    - MEM_IO
    - MEM_IO_8
    - MEM_IO_16
    - MEM_IO_32
    - MEM_IO_64
    allocatable: false
    shared: false
  virtio_mmio@a001000:
    path: /virtio_mmio@a001000
    name: virtio_mmio@a001000
    phandle:
    compatible:
    - virtio,mmio
    interrupts:
    - type: 0x0
      num: 24
      flags: 0x1
    aliases: []
    clock_names: []
    clocks: []
    clock_output_names: []
    clock_cells: 0
    physical_start_addr: 0xa001000
    virtual_start_addr: 0xa001000
    size: 0x200
    flags:
    - MEM_READ
    - MEM_WRITE
    - MEM_IO
    - MEM_IO_8
    - MEM_IO_16
    - MEM_IO_32
    - MEM_IO_64
    allocatable: false
    shared: false
  virtio_mmio@a001200:
    path: /virtio_mmio@a001200
    name: virtio_mmio@a001200
    phandle:
    compatible:
    - virtio,mmio
    interrupts:
    - type: 0x0
      num: 25
      flags: 0x1
    aliases: []
    clock_names: []
    clocks: []
    clock_output_names: []
    clock_cells: 0
    physical_start_addr: 0xa001200
    virtual_start_addr: 0xa001200
    size: 0x200
    flags:
    - MEM_READ
    - MEM_WRITE
    - MEM_IO
    - MEM_IO_8
    - MEM_IO_16
    - MEM_IO_32
    - MEM_IO_64
    allocatable: false
    shared: false
  virtio_mmio@a001400:
    path: /virtio_mmio@a001400
    name: virtio_mmio@a001400
    phandle:
    compatible:
    - virtio,mmio
    interrupts:
    - type: 0x0
      num: 26
      flags: 0x1
    aliases: []
    clock_names: []
    clocks: []
    clock_output_names: []
    clock_cells: 0
    physical_start_addr: 0xa001400
    virtual_start_addr: 0xa001400
    size: 0x200
    flags:
    - MEM_READ
    - MEM_WRITE
    - MEM_IO
    - MEM_IO_8
    - MEM_IO_16
    - MEM_IO_32
    - MEM_IO_64
    allocatable: false
    shared: false
  virtio_mmio@a001600:
    path: /virtio_mmio@a001600
    name: virtio_mmio@a001600
    phandle:
    compatible:
    - virtio,mmio
    interrupts:
    - type: 0x0
      num: 27
      flags: 0x1
    aliases: []
    clock_names: []
    clocks: []
    clock_output_names: []
    clock_cells: 0
    physical_start_addr: 0xa001600
    virtual_start_addr: 0xa001600
    size: 0x200
    flags:
    - MEM_READ
    - MEM_WRITE
    - MEM_IO
    - MEM_IO_8
    - MEM_IO_16
    - MEM_IO_32
    - MEM_IO_64
    allocatable: false
    shared: false
  virtio_mmio@a001800:
    path: /virtio_mmio@a001800
    name: virtio_mmio@a001800
    phandle:
    compatible:
    - virtio,mmio
    interrupts:
    - type: 0x0
      num: 28
      flags: 0x1
    aliases: []
    clock_names: []
    clocks: []
    clock_output_names: []
    clock_cells: 0
    physical_start_addr: 0xa001800
    virtual_start_addr: 0xa001800
    size: 0x200
    flags:
    - MEM_READ
    - MEM_WRITE
    - MEM_IO
    - MEM_IO_8
    - MEM_IO_16
    - MEM_IO_32
    - MEM_IO_64
    allocatable: false
    shared: false
  virtio_mmio@a001a00:
    path: /virtio_mmio@a001a00
    name: virtio_mmio@a001a00
    phandle:
    compatible:
    - virtio,mmio
    interrupts:
    - type: 0x0
      num: 29
      flags: 0x1
    aliases: []
    clock_names: []
    clocks: []
    clock_output_names: []
    clock_cells: 0
    physical_start_addr: 0xa001a00
    virtual_start_addr: 0xa001a00
    size: 0x200
    flags:
    - MEM_READ
    - MEM_WRITE
    - MEM_IO
    - MEM_IO_8
    - MEM_IO_16
    - MEM_IO_32
    - MEM_IO_64
    allocatable: false
    shared: false
  virtio_mmio@a001c00:
    path: /virtio_mmio@a001c00
    name: virtio_mmio@a001c00
    phandle:
    compatible:
    - virtio,mmio
    interrupts:
    - type: 0x0
      num: 30
      flags: 0x1
    aliases: []
    clock_names: []
    clocks: []
    clock_output_names: []
    clock_cells: 0
    physical_start_addr: 0xa001c00
    virtual_start_addr: 0xa001c00
    size: 0x200
    flags:
    - MEM_READ
    - MEM_WRITE
    - MEM_IO
    - MEM_IO_8
    - MEM_IO_16
    - MEM_IO_32
    - MEM_IO_64
    allocatable: false
    shared: false
  virtio_mmio@a001e00:
    path: /virtio_mmio@a001e00
    name: virtio_mmio@a001e00
    phandle:
    compatible:
    - virtio,mmio
    interrupts:
    - type: 0x0
      num: 31
      flags: 0x1
    aliases: []
    clock_names: []
    clocks: []
    clock_output_names: []
    clock_cells: 0
    physical_start_addr: 0xa001e00
    virtual_start_addr: 0xa001e00
    size: 0x200
    flags:
    - MEM_READ
    - MEM_WRITE
    - MEM_IO
    - MEM_IO_8
    - MEM_IO_16
    - MEM_IO_32
    - MEM_IO_64
    allocatable: false
    shared: false
  virtio_mmio@a002000:
    path: /virtio_mmio@a002000
    name: virtio_mmio@a002000
    phandle:
    compatible:
    - virtio,mmio
    interrupts:
    - type: 0x0
      num: 32
      flags: 0x1
    aliases: []
    clock_names: []
    clocks: []
    clock_output_names: []
    clock_cells: 0
    physical_start_addr: 0xa002000
    virtual_start_addr: 0xa002000
    size: 0x200
    flags:
    - MEM_READ
    - MEM_WRITE
    - MEM_IO
    - MEM_IO_8
    - MEM_IO_16
    - MEM_IO_32
    - MEM_IO_64
    allocatable: false
    shared: false
  virtio_mmio@a002200:
    path: /virtio_mmio@a002200
    name: virtio_mmio@a002200
    phandle:
    compatible:
    - virtio,mmio
    interrupts:
    - type: 0x0
      num: 33
      flags: 0x1
    aliases: []
    clock_names: []
    clocks: []
    clock_output_names: []
    clock_cells: 0
    physical_start_addr: 0xa002200
    virtual_start_addr: 0xa002200
    size: 0x200
    flags:
    - MEM_READ
    - MEM_WRITE
    - MEM_IO
    - MEM_IO_8
    - MEM_IO_16
    - MEM_IO_32
    - MEM_IO_64
    allocatable: false
    shared: false
  virtio_mmio@a002400:
    path: /virtio_mmio@a002400
    name: virtio_mmio@a002400
    phandle:
    compatible:
    - virtio,mmio
    interrupts:
    - type: 0x0
      num: 34
      flags: 0x1
    aliases: []
    clock_names: []
    clocks: []
    clock_output_names: []
    clock_cells: 0
    physical_start_addr: 0xa002400
    virtual_start_addr: 0xa002400
    size: 0x200
    flags:
    - MEM_READ
    - MEM_WRITE
    - MEM_IO
    - MEM_IO_8
    - MEM_IO_16
    - MEM_IO_32
    - MEM_IO_64
    allocatable: false
    shared: false
  virtio_mmio@a002600:
    path: /virtio_mmio@a002600
    name: virtio_mmio@a002600
    phandle:
    compatible:
    - virtio,mmio
    interrupts:
    - type: 0x0
      num: 35
      flags: 0x1
    aliases: []
    clock_names: []
    clocks: []
    clock_output_names: []
    clock_cells: 0
    physical_start_addr: 0xa002600
    virtual_start_addr: 0xa002600
    size: 0x200
    flags:
    - MEM_READ
    - MEM_WRITE
    - MEM_IO
    - MEM_IO_8
    - MEM_IO_16
    - MEM_IO_32
    - MEM_IO_64
    allocatable: false
    shared: false
  virtio_mmio@a002800:
    path: /virtio_mmio@a002800
    name: virtio_mmio@a002800
    phandle:
    compatible:
    - virtio,mmio
    interrupts:
    - type: 0x0
      num: 36
      flags: 0x1
    aliases: []
    clock_names: []
    clocks: []
    clock_output_names: []
    clock_cells: 0
    physical_start_addr: 0xa002800
    virtual_start_addr: 0xa002800
    size: 0x200
    flags:
    - MEM_READ
    - MEM_WRITE
    - MEM_IO
    - MEM_IO_8
    - MEM_IO_16
    - MEM_IO_32
    - MEM_IO_64
    allocatable: false
    shared: false
  virtio_mmio@a002a00:
    path: /virtio_mmio@a002a00
    name: virtio_mmio@a002a00
    phandle:
    compatible:
    - virtio,mmio
    interrupts:
    - type: 0x0
      num: 37
      flags: 0x1
    aliases: []
    clock_names: []
    clocks: []
    clock_output_names: []
    clock_cells: 0
    physical_start_addr: 0xa002a00
    virtual_start_addr: 0xa002a00
    size: 0x200
    flags:
    - MEM_READ
    - MEM_WRITE
    - MEM_IO
    - MEM_IO_8
    - MEM_IO_16
    - MEM_IO_32
    - MEM_IO_64
    allocatable: false
    shared: false
  virtio_mmio@a002c00:
    path: /virtio_mmio@a002c00
    name: virtio_mmio@a002c00
    phandle:
    compatible:
    - virtio,mmio
    interrupts:
    - type: 0x0
      num: 38
      flags: 0x1
    aliases: []
    clock_names: []
    clocks: []
    clock_output_names: []
    clock_cells: 0
    physical_start_addr: 0xa002c00
    virtual_start_addr: 0xa002c00
    size: 0x200
    flags:
    - MEM_READ
    - MEM_WRITE
    - MEM_IO
    - MEM_IO_8
    - MEM_IO_16
    - MEM_IO_32
    - MEM_IO_64
    allocatable: false
    shared: false
  virtio_mmio@a002e00:
    path: /virtio_mmio@a002e00
    name: virtio_mmio@a002e00
    phandle:
    compatible:
    - virtio,mmio
    interrupts:
    - type: 0x0
      num: 39
      flags: 0x1
    aliases: []
    clock_names: []
    clocks: []
    clock_output_names: []
    clock_cells: 0
    physical_start_addr: 0xa002e00
    virtual_start_addr: 0xa002e00
    size: 0x200
    flags:
    - MEM_READ
    - MEM_WRITE
    - MEM_IO
    - MEM_IO_8
    - MEM_IO_16
    - MEM_IO_32
    - MEM_IO_64
    allocatable: false
    shared: false
  virtio_mmio@a003000:
    path: /virtio_mmio@a003000
    name: virtio_mmio@a003000
    phandle:
    compatible:
    - virtio,mmio
    interrupts:
    - type: 0x0
      num: 40
      flags: 0x1
    aliases: []
    clock_names: []
    clocks: []
    clock_output_names: []
    clock_cells: 0
    physical_start_addr: 0xa003000
    virtual_start_addr: 0xa003000
    size: 0x200
    flags:
    - MEM_READ
    - MEM_WRITE
    - MEM_IO
    - MEM_IO_8
    - MEM_IO_16
    - MEM_IO_32
    - MEM_IO_64
    allocatable: false
    shared: false
  virtio_mmio@a003200:
    path: /virtio_mmio@a003200
    name: virtio_mmio@a003200
    phandle:
    compatible:
    - virtio,mmio
    interrupts:
    - type: 0x0
      num: 41
      flags: 0x1
    aliases: []
    clock_names: []
    clocks: []
    clock_output_names: []
    clock_cells: 0
    physical_start_addr: 0xa003200
    virtual_start_addr: 0xa003200
    size: 0x200
    flags:
    - MEM_READ
    - MEM_WRITE
    - MEM_IO
    - MEM_IO_8
    - MEM_IO_16
    - MEM_IO_32
    - MEM_IO_64
    allocatable: false
    shared: false
  virtio_mmio@a003400:
    path: /virtio_mmio@a003400
    name: virtio_mmio@a003400
    phandle:
    compatible:
    - virtio,mmio
    interrupts:
    - type: 0x0
      num: 42
      flags: 0x1
    aliases: []
    clock_names: []
    clocks: []
    clock_output_names: []
    clock_cells: 0
    physical_start_addr: 0xa003400
    virtual_start_addr: 0xa003400
    size: 0x200
    flags:
    - MEM_READ
    - MEM_WRITE
    - MEM_IO
    - MEM_IO_8
    - MEM_IO_16
    - MEM_IO_32
    - MEM_IO_64
    allocatable: false
    shared: false
  virtio_mmio@a003600:
    path: /virtio_mmio@a003600
    name: virtio_mmio@a003600
    phandle:
    compatible:
    - virtio,mmio
    interrupts:
    - type: 0x0
      num: 43
      flags: 0x1
    aliases: []
    clock_names: []
    clocks: []
    clock_output_names: []
    clock_cells: 0
    physical_start_addr: 0xa003600
    virtual_start_addr: 0xa003600
    size: 0x200
    flags:
    - MEM_READ
    - MEM_WRITE
    - MEM_IO
    - MEM_IO_8
    - MEM_IO_16
    - MEM_IO_32
    - MEM_IO_64
    allocatable: false
    shared: false
  virtio_mmio@a003800:
    path: /virtio_mmio@a003800
    name: virtio_mmio@a003800
    phandle:
    compatible:
    - virtio,mmio
    interrupts:
    - type: 0x0
      num: 44
      flags: 0x1
    aliases: []
    clock_names: []
    clocks: []
    clock_output_names: []
    clock_cells: 0
    physical_start_addr: 0xa003800
    virtual_start_addr: 0xa003800
    size: 0x200
    flags:
    - MEM_READ
    - MEM_WRITE
    - MEM_IO
    - MEM_IO_8
    - MEM_IO_16
    - MEM_IO_32
    - MEM_IO_64
    allocatable: false
    shared: false
  virtio_mmio@a003a00:
    path: /virtio_mmio@a003a00
    name: virtio_mmio@a003a00
    phandle:
    compatible:
    - virtio,mmio
    interrupts:
    - type: 0x0
      num: 45
      flags: 0x1
    aliases: []
    clock_names: []
    clocks: []
    clock_output_names: []
    clock_cells: 0
    physical_start_addr: 0xa003a00
    virtual_start_addr: 0xa003a00
    size: 0x200
    flags:
    - MEM_READ
    - MEM_WRITE
    - MEM_IO
    - MEM_IO_8
    - MEM_IO_16
    - MEM_IO_32
    - MEM_IO_64
    allocatable: false
    shared: false
  virtio_mmio@a003c00:
    path: /virtio_mmio@a003c00
    name: virtio_mmio@a003c00
    phandle:
    compatible:
    - virtio,mmio
    interrupts:
    - type: 0x0
      num: 46
      flags: 0x1
    aliases: []
    clock_names: []
    clocks: []
    clock_output_names: []
    clock_cells: 0
    physical_start_addr: 0xa003c00
    virtual_start_addr: 0xa003c00
    size: 0x200
    flags:
    - MEM_READ
    - MEM_WRITE
    - MEM_IO
    - MEM_IO_8
    - MEM_IO_16
    - MEM_IO_32
    - MEM_IO_64
    allocatable: false
    shared: false
  virtio_mmio@a003e00:
    path: /virtio_mmio@a003e00
    name: virtio_mmio@a003e00
    phandle:
    compatible:
    - virtio,mmio
    interrupts:
    - type: 0x0
      num: 47
      flags: 0x1
    aliases: []
    clock_names: []
    clocks: []
    clock_output_names: []
    clock_cells: 0
    physical_start_addr: 0xa003e00
    virtual_start_addr: 0xa003e00
    size: 0x200
    flags:
    - MEM_READ
    - MEM_WRITE
    - MEM_IO
    - MEM_IO_8
    - MEM_IO_16
    - MEM_IO_32
    - MEM_IO_64
    allocatable: false
    shared: false
  memory@40000000:
    path:
    name: memory@40000000
    physical_start_addr: 0x40000000
    virtual_start_addr: 0x40000000
    size: 0x100000000
    flags:
    - MEM_READ
    - MEM_WRITE
    - MEM_EXECUTE
    allocatable: true
    shared: false
  pcie@10000000:
    path: /pcie@10000000
    name: pcie@10000000
    phandle:
    compatible:
    - pci-host-ecam-generic
    interrupts: []
    aliases: []
    clock_names: []
    clocks: []
    clock_output_names: []
    clock_cells: 0
    physical_start_addr: 0x4010000000
    virtual_start_addr: 0x4010000000
    size: 0x10000000
    flags:
    - MEM_READ
    - MEM_WRITE
    - MEM_IO
    - MEM_IO_8
    - MEM_IO_16
    - MEM_IO_32
    - MEM_IO_64
    allocatable: false
    shared: false
cpuinfo:
  cpu@0:
    name: cpu@0
    num: 0
    compatible: arm,cortex-a57
    enable_method: psci
    next_level_cache:
  cpu@1:
    name: cpu@1
    num: 1
    compatible: arm,cortex-a57
    enable_method: psci
    next_level_cache:
  cpu@2:
    name: cpu@2
    num: 2
    compatible: arm,cortex-a57
    enable_method: psci
    next_level_cache:
  cpu@3:
    name: cpu@3
    num: 3
    compatible: arm,cortex-a57
    enable_method: psci
    next_level_cache:
  cpu@4:
    name: cpu@4
    num: 4
    compatible: arm,cortex-a57
    enable_method: psci
    next_level_cache:
  cpu@5:
    name: cpu@5
    num: 5
    compatible: arm,cortex-a57
    enable_method: psci
    next_level_cache:
  cpu@6:
    name: cpu@6
    num: 6
    compatible: arm,cortex-a57
    enable_method: psci
    next_level_cache:
  cpu@7:
    name: cpu@7
    num: 7
    compatible: arm,cortex-a57
    enable_method: psci
    next_level_cache:
  cpu@8:
    name: cpu@8
    num: 8
    compatible: arm,cortex-a57
    enable_method: psci
    next_level_cache:
  cpu@9:
    name: cpu@9
    num: 9
    compatible: arm,cortex-a57
    enable_method: psci
    next_level_cache:
  cpu@10:
    name: cpu@10
    num: 10
    compatible: arm,cortex-a57
    enable_method: psci
    next_level_cache:
  cpu@11:
    name: cpu@11
    num: 11
    compatible: arm,cortex-a57
    enable_method: psci
    next_level_cache:
  cpu@12:
    name: cpu@12
    num: 12
    compatible: arm,cortex-a57
    enable_method: psci
    next_level_cache:
  cpu@13:
    name: cpu@13
    num: 13
    compatible: arm,cortex-a57
    enable_method: psci
    next_level_cache:
  cpu@14:
    name: cpu@14
    num: 14
    compatible: arm,cortex-a57
    enable_method: psci
    next_level_cache:
  cpu@15:
    name: cpu@15
    num: 15
    compatible: arm,cortex-a57
    enable_method: psci
    next_level_cache:
interrupt_controllers:
- maintenance_irq: 25
  compatible:
  - arm,gic-v3
  gic_version: 3
  gicd_base: 0x8000000
  gicc_base: 0x0
  gich_base: 0x0
  gicv_base: 0x0
  gicr_base: 0x80a0000
  interrupts: 23,26,27,29,30,33,34,39,48,49,50,51,52,53,54,55,56,57,58,59,60,61,62,63,64,65,66,67,68,69,70,71,72,73,74,75,76,77,78,79
clock_tree:
  clk24mhz:
    name: clk24mhz
    enable_count: 4
    prepare_count: 5
    protect_count: 0
    rate: 24000000
    accuracy: 0
    phase: 0
    duty_cycle: 50000
    derived_clocks: {}
    parent:
clock_mapping:
  pl061@9030000:
  - parent_name: clk24mhz
    rate:
  pl031@9010000:
  - parent_name: clk24mhz
    rate:
  pl011@9000000:
  - parent_name: clk24mhz
    rate:
  - parent_name: clk24mhz
    rate:
devices:
  /:
    path: ///
    name: /
    phandle:
    compatible:
    - linux,dummy-virt
    interrupts: []
    aliases: []
    clock_names: []
    clocks: []
    clock_output_names: []
    clock_cells: 0
  flash@0:
    path: /flash@0
    name: flash@0
    phandle:
    compatible:
    - cfi-flash
    interrupts: []
    aliases: []
    clock_names: []
    clocks: []
    clock_output_names: []
    clock_cells: 0
  flash@0.0:
    path: /flash@0
    name: flash@0
    phandle:
    compatible:
    - cfi-flash
    interrupts: []
    aliases: []
    clock_names: []
    clocks: []
    clock_output_names: []
    clock_cells: 0
  pmu:
    path: //pmu
    name: pmu
    phandle:
    compatible:
    - arm,armv8-pmuv3
    interrupts:
    - type: 0x1
      num: 7
      flags: 0x4
    aliases: []
    clock_names: []
    clocks: []
    clock_output_names: []
    clock_cells: 0
  virtio_mmio@a002a00:
    path: /virtio_mmio@a002a00
    name: virtio_mmio@a002a00
    phandle:
    compatible:
    - virtio,mmio
    interrupts:
    - type: 0x0
      num: 37
      flags: 0x1
    aliases: []
    clock_names: []
    clocks: []
    clock_output_names: []
    clock_cells: 0
  virtio_mmio@a003e00:
    path: /virtio_mmio@a003e00
    name: virtio_mmio@a003e00
    phandle:
    compatible:
    - virtio,mmio
    interrupts:
    - type: 0x0
      num: 47
      flags: 0x1
    aliases: []
    clock_names: []
    clocks: []
    clock_output_names: []
    clock_cells: 0
  pl031@9010000:
    path: /pl031@9010000
    name: pl031@9010000
    phandle:
    compatible:
    - arm,pl031
    - arm,primecell
    interrupts:
    - type: 0x0
      num: 2
      flags: 0x4
    aliases: []
    clock_names:
    - apb_pclk
    clocks:
    - '32768'
    clock_output_names: []
    clock_cells: 0
  virtio_mmio@a003c00:
    path: /virtio_mmio@a003c00
    name: virtio_mmio@a003c00
    phandle:
    compatible:
    - virtio,mmio
    interrupts:
    - type: 0x0
      num: 46
      flags: 0x1
    aliases: []
    clock_names: []
    clocks: []
    clock_output_names: []
    clock_cells: 0
  pl011@9000000:
    path: /pl011@9000000
    name: pl011@9000000
    phandle:
    compatible:
    - arm,pl011
    - arm,primecell
    interrupts:
    - type: 0x0
      num: 1
      flags: 0x4
    aliases: []
    clock_names:
    - uartclk
    - apb_pclk
    clocks:
    - '32768'
    - '32768'
    clock_output_names: []
    clock_cells: 0
  timer:
    path: //timer
    name: timer
    phandle:
    compatible:
    - arm,armv8-timer
    - arm,armv7-timer
    interrupts:
    - type: 0x1
      num: 13
      flags: 0x4
    - type: 0x1
      num: 14
      flags: 0x4
    - type: 0x1
      num: 11
      flags: 0x4
    - type: 0x1
      num: 10
      flags: 0x4
    aliases: []
    clock_names: []
    clocks: []
    clock_output_names: []
    clock_cells: 0
  virtio_mmio@a000000:
    path: /virtio_mmio@a000000
    name: virtio_mmio@a000000
    phandle:
    compatible:
    - virtio,mmio
    interrupts:
    - type: 0x0
      num: 16
      flags: 0x1
    aliases: []
    clock_names: []
    clocks: []
    clock_output_names: []
    clock_cells: 0
  virtio_mmio@a000400:
    path: /virtio_mmio@a000400
    name: virtio_mmio@a000400
    phandle:
    compatible:
    - virtio,mmio
    interrupts:
    - type: 0x0
      num: 18
      flags: 0x1
    aliases: []
    clock_names: []
    clocks: []
    clock_output_names: []
    clock_cells: 0
  virtio_mmio@a002e00:
    path: /virtio_mmio@a002e00
    name: virtio_mmio@a002e00
    phandle:
    compatible:
    - virtio,mmio
    interrupts:
    - type: 0x0
      num: 39
      flags: 0x1
    aliases: []
    clock_names: []
    clocks: []
    clock_output_names: []
    clock_cells: 0
  platform@c000000:
    path: //platform@c000000
    name: platform@c000000
    phandle:
    compatible:
    - qemu,platform
    - simple-bus
    interrupts: []
    aliases: []
    clock_names: []
    clocks: []
    clock_output_names: []
    clock_cells: 0
  virtio_mmio@a002800:
    path: /virtio_mmio@a002800
    name: virtio_mmio@a002800
    phandle:
    compatible:
    - virtio,mmio
    interrupts:
    - type: 0x0
      num: 36
      flags: 0x1
    aliases: []
    clock_names: []
    clocks: []
    clock_output_names: []
    clock_cells: 0
  virtio_mmio@a001200:
    path: /virtio_mmio@a001200
    name: virtio_mmio@a001200
    phandle:
    compatible:
    - virtio,mmio
    interrupts:
    - type: 0x0
      num: 25
      flags: 0x1
    aliases: []
    clock_names: []
    clocks: []
    clock_output_names: []
    clock_cells: 0
  pcie@10000000:
    path: /pcie@10000000
    name: pcie@10000000
    phandle:
    compatible:
    - pci-host-ecam-generic
    interrupts: []
    aliases: []
    clock_names: []
    clocks: []
    clock_output_names: []
    clock_cells: 0
  virtio_mmio@a001800:
    path: /virtio_mmio@a001800
    name: virtio_mmio@a001800
    phandle:
    compatible:
    - virtio,mmio
    interrupts:
    - type: 0x0
      num: 28
      flags: 0x1
    aliases: []
    clock_names: []
    clocks: []
    clock_output_names: []
    clock_cells: 0
  virtio_mmio@a000e00:
    path: /virtio_mmio@a000e00
    name: virtio_mmio@a000e00
    phandle:
    compatible:
    - virtio,mmio
    interrupts:
    - type: 0x0
      num: 23
      flags: 0x1
    aliases: []
    clock_names: []
    clocks: []
    clock_output_names: []
    clock_cells: 0
  virtio_mmio@a002c00:
    path: /virtio_mmio@a002c00
    name: virtio_mmio@a002c00
    phandle:
    compatible:
    - virtio,mmio
    interrupts:
    - type: 0x0
      num: 38
      flags: 0x1
    aliases: []
    clock_names: []
    clocks: []
    clock_output_names: []
    clock_cells: 0
  virtio_mmio@a003200:
    path: /virtio_mmio@a003200
    name: virtio_mmio@a003200
    phandle:
    compatible:
    - virtio,mmio
    interrupts:
    - type: 0x0
      num: 41
      flags: 0x1
    aliases: []
    clock_names: []
    clocks: []
    clock_output_names: []
    clock_cells: 0
  virtio_mmio@a000a00:
    path: /virtio_mmio@a000a00
    name: virtio_mmio@a000a00
    phandle:
    compatible:
    - virtio,mmio
    interrupts:
    - type: 0x0
      num: 21
      flags: 0x1
    aliases: []
    clock_names: []
    clocks: []
    clock_output_names: []
    clock_cells: 0
  virtio_mmio@a000600:
    path: /virtio_mmio@a000600
    name: virtio_mmio@a000600
    phandle:
    compatible:
    - virtio,mmio
    interrupts:
    - type: 0x0
      num: 19
      flags: 0x1
    aliases: []
    clock_names: []
    clocks: []
    clock_output_names: []
    clock_cells: 0
  virtio_mmio@a001a00:
    path: /virtio_mmio@a001a00
    name: virtio_mmio@a001a00
    phandle:
    compatible:
    - virtio,mmio
    interrupts:
    - type: 0x0
      num: 29
      flags: 0x1
    aliases: []
    clock_names: []
    clocks: []
    clock_output_names: []
    clock_cells: 0
  pl061@9030000:
    path: /pl061@9030000
    name: pl061@9030000
    phandle: 32770
    compatible:
    - arm,pl061
    - arm,primecell
    interrupts:
    - type: 0x0
      num: 7
      flags: 0x4
    aliases: []
    clock_names:
    - apb_pclk
    clocks:
    - '32768'
    clock_output_names: []
    clock_cells: 0
  virtio_mmio@a000c00:
    path: /virtio_mmio@a000c00
    name: virtio_mmio@a000c00
    phandle:
    compatible:
    - virtio,mmio
    interrupts:
    - type: 0x0
      num: 22
      flags: 0x1
    aliases: []
    clock_names: []
    clocks: []
    clock_output_names: []
    clock_cells: 0
  virtio_mmio@a002600:
    path: /virtio_mmio@a002600
    name: virtio_mmio@a002600
    phandle:
    compatible:
    - virtio,mmio
    interrupts:
    - type: 0x0
      num: 35
      flags: 0x1
    aliases: []
    clock_names: []
    clocks: []
    clock_output_names: []
    clock_cells: 0
  virtio_mmio@a002400:
    path: /virtio_mmio@a002400
    name: virtio_mmio@a002400
    phandle:
    compatible:
    - virtio,mmio
    interrupts:
    - type: 0x0
      num: 34
      flags: 0x1
    aliases: []
    clock_names: []
    clocks: []
    clock_output_names: []
    clock_cells: 0
  psci:
    path: //psci
    name: psci
    phandle:
    compatible:
    - arm,psci-0.2
    - arm,psci
    interrupts: []
    aliases: []
    clock_names: []
    clocks: []
    clock_output_names: []
    clock_cells: 0
  virtio_mmio@a002200:
    path: /virtio_mmio@a002200
    name: virtio_mmio@a002200
    phandle:
    compatible:
    - virtio,mmio
    interrupts:
    - type: 0x0
      num: 33
      flags: 0x1
    aliases: []
    clock_names: []
    clocks: []
    clock_output_names: []
    clock_cells: 0
  virtio_mmio@a001400:
    path: /virtio_mmio@a001400
    name: virtio_mmio@a001400
    phandle:
    compatible:
    - virtio,mmio
    interrupts:
    - type: 0x0
      num: 26
      flags: 0x1
    aliases: []
    clock_names: []
    clocks: []
    clock_output_names: []
    clock_cells: 0
  virtio_mmio@a003000:
    path: /virtio_mmio@a003000
    name: virtio_mmio@a003000
    phandle:
    compatible:
    - virtio,mmio
    interrupts:
    - type: 0x0
      num: 40
      flags: 0x1
    aliases: []
    clock_names: []
    clocks: []
    clock_output_names: []
    clock_cells: 0
  apb-pclk:
    path: //apb-pclk
    name: apb-pclk
    phandle: 32768
    compatible:
    - fixed-clock
    interrupts: []
    aliases: []
    clock_names: []
    clocks: []
    clock_output_names:
    - clk24mhz
    clock_cells: 0
  virtio_mmio@a003400:
    path: /virtio_mmio@a003400
    name: virtio_mmio@a003400
    phandle:
    compatible:
    - virtio,mmio
    interrupts:
    - type: 0x0
      num: 42
      flags: 0x1
    aliases: []
    clock_names: []
    clocks: []
    clock_output_names: []
    clock_cells: 0
  virtio_mmio@a001000:
    path: /virtio_mmio@a001000
    name: virtio_mmio@a001000
    phandle:
    compatible:
    - virtio,mmio
    interrupts:
    - type: 0x0
      num: 24
      flags: 0x1
    aliases: []
    clock_names: []
    clocks: []
    clock_output_names: []
    clock_cells: 0
  virtio_mmio@a002000:
    path: /virtio_mmio@a002000
    name: virtio_mmio@a002000
    phandle:
    compatible:
    - virtio,mmio
    interrupts:
    - type: 0x0
      num: 32
      flags: 0x1
    aliases: []
    clock_names: []
    clocks: []
    clock_output_names: []
    clock_cells: 0
  virtio_mmio@a001c00:
    path: /virtio_mmio@a001c00
    name: virtio_mmio@a001c00
    phandle:
    compatible:
    - virtio,mmio
    interrupts:
    - type: 0x0
      num: 30
      flags: 0x1
    aliases: []
    clock_names: []
    clocks: []
    clock_output_names: []
    clock_cells: 0
  virtio_mmio@a003800:
    path: /virtio_mmio@a003800
    name: virtio_mmio@a003800
    phandle:
    compatible:
    - virtio,mmio
    interrupts:
    - type: 0x0
      num: 44
      flags: 0x1
    aliases: []
    clock_names: []
    clocks: []
    clock_output_names: []
    clock_cells: 0
  virtio_mmio@a001e00:
    path: /virtio_mmio@a001e00
    name: virtio_mmio@a001e00
    phandle:
    compatible:
    - virtio,mmio
    interrupts:
    - type: 0x0
      num: 31
      flags: 0x1
    aliases: []
    clock_names: []
    clocks: []
    clock_output_names: []
    clock_cells: 0
  virtio_mmio@a000800:
    path: /virtio_mmio@a000800
    name: virtio_mmio@a000800
    phandle:
    compatible:
    - virtio,mmio
    interrupts:
    - type: 0x0
      num: 20
      flags: 0x1
    aliases: []
    clock_names: []
    clocks: []
    clock_output_names: []
    clock_cells: 0
  virtio_mmio@a000200:
    path: /virtio_mmio@a000200
    name: virtio_mmio@a000200
    phandle:
    compatible:
    - virtio,mmio
    interrupts:
    - type: 0x0
      num: 17
      flags: 0x1
    aliases: []
    clock_names: []
    clocks: []
    clock_output_names: []
    clock_cells: 0
  fw-cfg@9020000:
    path: /fw-cfg@9020000
    name: fw-cfg@9020000
    phandle:
    compatible:
    - qemu,fw-cfg-mmio
    interrupts: []
    aliases: []
    clock_names: []
    clocks: []
    clock_output_names: []
    clock_cells: 0
  gpio-keys:
    path: //gpio-keys
    name: gpio-keys
    phandle:
    compatible:
    - gpio-keys
    interrupts: []
    aliases: []
    clock_names: []
    clocks: []
    clock_output_names: []
    clock_cells: 0
  virtio_mmio@a003a00:
    path: /virtio_mmio@a003a00
    name: virtio_mmio@a003a00
    phandle:
    compatible:
    - virtio,mmio
    interrupts:
    - type: 0x0
      num: 45
      flags: 0x1
    aliases: []
    clock_names: []
    clocks: []
    clock_output_names: []
    clock_cells: 0
  virtio_mmio@a001600:
    path: /virtio_mmio@a001600
    name: virtio_mmio@a001600
    phandle:
    compatible:
    - virtio,mmio
    interrupts:
    - type: 0x0
      num: 27
      flags: 0x1
    aliases: []
    clock_names: []
    clocks: []
    clock_output_names: []
    clock_cells: 0
  virtio_mmio@a003600:
    path: /virtio_mmio@a003600
    name: virtio_mmio@a003600
    phandle:
    compatible:
    - virtio,mmio
    interrupts:
    - type: 0x0
      num: 43
      flags: 0x1
    aliases: []
    clock_names: []
    clocks: []
    clock_output_names: []
    clock_cells: 0
ip_info:
- ifindex: 1
  ifname: lo
  flags:
  - LOOPBACK
  - UP
  - LOWER_UP
  mtu: 65536
  qdisc: noqueue
  operstate: UNKNOWN
  group: default
  txqlen: 1000
  link_type: loopback
  address: 00:00:00:00:00:00
  broadcast: 00:00:00:00:00:00
  addr_info:
  - family: inet
    local: 127.0.0.1
    prefixlen: 8
    scope: host
    label: lo
    valid_life_time: 4294967295
    preferred_life_time: 4294967295
  - family: inet6
    local: ::1
    prefixlen: 128
    scope: host
    valid_life_time: 4294967295
    preferred_life_time: 4294967295
- ifindex: 2
  ifname: eth0
  flags:
  - BROADCAST
  - MULTICAST
  - UP
  - LOWER_UP
  mtu: 1500
  qdisc: pfifo_fast
  operstate: UP
  group: default
  txqlen: 1000
  link_type: ether
  address: 52:54:00:12:34:56
  broadcast: ff:ff:ff:ff:ff:ff
  addr_info:
  - family: inet
    local: 10.0.2.15
    prefixlen: 24
    broadcast: 10.0.2.255
    scope: global
    dynamic: true
    label: eth0
    valid_life_time: 63038
    preferred_life_time: 63038
  - family: inet6
    local: fec0::5054:ff:fe12:3456
    prefixlen: 64
    scope: site
    dynamic: true
    mngtmpaddr: true
    valid_life_time: 86311
    preferred_life_time: 14311
  - family: inet6
    local: fe80::5054:ff:fe12:3456
    prefixlen: 64
    scope: link
    valid_life_time: 4294967295
    preferred_life_time: 4294967295
hw_info: []
```
