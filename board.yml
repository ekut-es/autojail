## board.yml
```yaml
name:"autojailExtract/board"
id:boardID
board: boardTyp
description: uses Input from "autojailhouse.yml"


physicalInformation:
	-reserved RAM size = 64MB
	//-starting und ending Adress of reserved RAM = 0x0000-0xFFFF
	-Device Tree Information (only arm/arm64 based board)
	-#CPUs:0x1-0xF

Hypervisor:
	-hyperVisorLocation:0x2000-0x2500
	-HyperVisorSize:0x500
memoryRegions:
	numberMemoryRegions: 0x0-0xF
	typeMemoryRegions:
		-UART:
			physicalStartAdr: 0x0000
			virtualStartAdr:0x0000
			size:0x10
			flags:UART_FLAGS

		-RAM:
			physicalStartAdr:0x0010
			virtualStartAdr:0x0010
			size:0x10
			flags:RAM_FLAGS

		-communicationRegion:
			physicalStartAdr:0x0020
			virtualStartAdr:0x0020
			size:0x50
			flags:COMMUNICATION_FLAGS

systemConfiguration:
	-debug console:
	       adress:0x1000
	       size:0x500
	       type:debugConsoleType
	       flags:debugConsoleFlags

Root cell:
     header:
	cellName:ROOT_CELL
	cellFlags:ROOT_CELL_FLAGS
	cellSize:reservedMemory
	cellSignature:ROOT_CELL_SIGNATURE
	cellRevision:ROOT_CELL_REVISION
```
